## boards/RFSoC4x2/edf_bsp/meta-remote/conf/layer.conf
```bitbake
BBPATH .= ":${LAYERDIR}"
BBFILES += "${LAYERDIR}/recipes-*/*/*.bb ${LAYERDIR}/recipes-*/*/*.bbappend"

BBFILE_COLLECTIONS += "rfsoc4x2_remote"
BBFILE_PATTERN_rfsoc4x2_remote = "^${LAYERDIR}/"
BBFILE_PRIORITY_rfsoc4x2_remote = "8"

LAYERSERIES_COMPAT_rfsoc4x2_remote = "scarthgap"
```

## boards/ZCU111/edf_bsp/meta-remote/conf/layer.conf
```bitbake
BBPATH .= ":${LAYERDIR}"
BBFILES += "${LAYERDIR}/recipes-*/*/*.bb ${LAYERDIR}/recipes-*/*/*.bbappend"

BBFILE_COLLECTIONS += "zcu111_remote"
BBFILE_PATTERN_zcu111_remote = "^${LAYERDIR}/"
BBFILE_PRIORITY_zcu111_remote = "8"

LAYERSERIES_COMPAT_zcu111_remote = "scarthgap"
```

## boards/ZCU208/edf_bsp/meta-remote/conf/layer.conf
```bitbake
BBPATH .= ":${LAYERDIR}"
BBFILES += "${LAYERDIR}/recipes-*/*/*.bb ${LAYERDIR}/recipes-*/*/*.bbappend"

BBFILE_COLLECTIONS += "zcu208_remote"
BBFILE_PATTERN_zcu208_remote = "^${LAYERDIR}/"
BBFILE_PRIORITY_zcu208_remote = "8"

LAYERSERIES_COMPAT_zcu208_remote = "scarthgap"
```
