## boards/ZCU216/edf_bsp/meta-remote/conf/layer.conf
```bitbake
BBPATH .= ":${LAYERDIR}"
BBFILES += "${LAYERDIR}/recipes-*/*/*.bb ${LAYERDIR}/recipes-*/*/*.bbappend"

BBFILE_COLLECTIONS += "zcu216_remote"
BBFILE_PATTERN_zcu216_remote = "^${LAYERDIR}/"
BBFILE_PRIORITY_zcu216_remote = "8"

LAYERSERIES_COMPAT_zcu216_remote = "scarthgap"
```
